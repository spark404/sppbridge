## main/Kconfig.projbuild
```kconfig
menu "SPPBridge Configuration"
    config PEER_HWADDR
        string "Bluetooth MAC"
        default "00:00:00:00:00:00"
        help
            Enter the mac address of your bluetooth device

    config PEER_PIN
        string "Bluetooth PIN"
        default "1234"
        help
            Enter the pin to authenticate with the bluetooth device

    config AP_ESSID
        string "ESSID for the AP"
        default "SppBridge"
        help
            The name of the announced WiFi network

    config AP_KEY
        string "WPA2 passphrase for the wifi network"
        default ""
        help
            The passphase required to connect to the AP, leave empty to create an open network
endmenu
```

## sdkconfig.defaults
```kconfig
# ESP32-CAM units have 4Mb flash
CONFIG_ESPTOOLPY_FLASHSIZE_4MB=y
CONFIG_ESPTOOLPY_FLASHSIZE="4MB"

# Enable bluetooth
CONFIG_BT_ENABLED=y
CONFIG_BTDM_CTRL_MODE_BLE_ONLY=n
CONFIG_BTDM_CTRL_MODE_BR_EDR_ONLY=y
CONFIG_BTDM_CTRL_MODE_BTDM=n
CONFIG_BT_CLASSIC_ENABLED=y
CONFIG_BT_SPP_ENABLED=y
CONFIG_BT_BLE_ENABLED=n
```
